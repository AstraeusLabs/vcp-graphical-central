## CMakeLists.txt
```
# Copyright (c) 2024 Demant A/S
# SPDX-License-Identifier: Apache-2.0

cmake_minimum_required(VERSION 3.20.0)
find_package(Zephyr REQUIRED HINTS $ENV{ZEPHYR_BASE})

project(vcp-graphical-central)

FILE(GLOB app_sources src/*.c)
target_sources(app PRIVATE ${app_sources})
```

## Kconfig
```
# Copyright (c) 2024 Demant A/S
# SPDX-License-Identifier: Apache-2.0

mainmenu "Bluetooth: Graphical VCP Central App"

config BT_TARGET_DEVICE_NUMBER
    int "Number of Bluetooth target devices"
    default 1
    help
      Specify the number of the target Bluetooth devices to be scanned for and connected to.

config BT_TARGET_DEVICE_NAME
    string "Bluetooth target device name"
    default ""
    help
      Specify the name of the target Bluetooth device to be scanned for and connected to.

config BT_TARGET_RSHI_DEVICE_NAME
    string "Bluetooth target right side stereo hearing instrument device name"
    default ""
    help
      Specify the name of the target Bluetooth right side stereo hearing instrument device
      to be scanned for and connected to.

config BT_TARGET_LSHI_DEVICE_NAME
    string "Bluetooth target left side stereo hearing instrument device name"
    default ""
    help
      Specify the name of the target Bluetooth left side stereo hearing instrument device
      to be scanned for and connected to.

source "Kconfig.zephyr"
```

## prj.conf
```kconfig
# Number of BT target devices
CONFIG_BT_TARGET_DEVICE_NUMBER=2

# BT target device name
# (Applicable if CONFIG_BT_TARGET_DEVICE_NUMBER=1)
CONFIG_BT_TARGET_DEVICE_NAME=""

# BT target right-side stereo device name
# (Applicable if CONFIG_BT_TARGET_DEVICE_NUMBER=2)
CONFIG_BT_TARGET_RSHI_DEVICE_NAME=""
# BT target left-side stereo device name
# (Applicable if CONFIG_BT_TARGET_DEVICE_NUMBER=2)
CONFIG_BT_TARGET_LSHI_DEVICE_NAME=""


# Stack Size
CONFIG_MAIN_STACK_SIZE=8192
CONFIG_SYSTEM_WORKQUEUE_STACK_SIZE=8192

# Display
CONFIG_DISPLAY=y
CONFIG_DISPLAY_LOG_LEVEL_ERR=y

# LVGL
CONFIG_LVGL=y
CONFIG_LV_Z_SHELL=y

CONFIG_LV_Z_MEM_POOL_SIZE=16384

CONFIG_LV_MEM_CUSTOM=y
CONFIG_LV_USE_LABEL=y
CONFIG_LV_USE_BTN=y
CONFIG_LV_USE_ARC=y
CONFIG_LV_USE_IMG=y
CONFIG_LV_USE_MONKEY=y
CONFIG_LV_FONT_MONTSERRAT_14=y

# BT
CONFIG_BT=y
CONFIG_BT_CENTRAL=y
CONFIG_BT_SMP=y
CONFIG_BT_AUDIO=y

CONFIG_BT_PRIVACY=y
CONFIG_BT_SIGNING=y
CONFIG_BT_REMOTE_INFO=y
CONFIG_BT_REMOTE_VERSION=y
CONFIG_BT_MAX_CONN=3
CONFIG_BT_MAX_PAIRED=3
CONFIG_BT_FIXED_PASSKEY=y

CONFIG_BT_EXT_ADV=y
CONFIG_BT_BONDABLE=y
CONFIG_BT_TINYCRYPT_ECC=y
CONFIG_BT_BUF_ACL_RX_SIZE=255
CONFIG_BT_BUF_ACL_TX_SIZE=251
CONFIG_BT_CTLR_SCAN_DATA_LEN_MAX=191

# Volume Control
CONFIG_BT_VCP_VOL_CTLR=y
CONFIG_BT_VCP_VOL_CTLR_MAX_VOCS_INST=1
CONFIG_BT_VCP_VOL_CTLR_MAX_AICS_INST=3
CONFIG_BT_VOCS_CLIENT_MAX_INSTANCE_COUNT=1
CONFIG_BT_AICS_CLIENT_MAX_INSTANCE_COUNT=3

# USB
CONFIG_RING_BUFFER=y
CONFIG_USB_DEVICE_STACK=y
CONFIG_USB_DEVICE_BOS=y
CONFIG_USB_DEVICE_PRODUCT="VCP Graphical Central"

CONFIG_PRINTK=y
CONFIG_SHELL=y

# DEBUGGING
CONFIG_DEBUG=y
CONFIG_LOG=y
CONFIG_LOG_RUNTIME_FILTERING=y
CONFIG_BT_AUDIO_LOG_LEVEL_DBG=y
CONFIG_BT_VCP_VOL_CTLR_LOG_LEVEL_DBG=y
CONFIG_BT_AICS_LOG_LEVEL_DBG=y
CONFIG_BT_VOCS_LOG_LEVEL_DBG=y
CONFIG_BT_AICS_CLIENT_LOG_LEVEL_DBG=n
CONFIG_BT_VOCS_CLIENT_LOG_LEVEL_DBG=n
CONFIG_LV_USE_LOG=n
```

## src/main.c
```c
/*
 * Copyright (c) 2024 Demant A/S
 * SPDX-License-Identifier: Apache-2.0
 */

#include <errno.h>
#include <stdlib.h>
#include <string.h>
#include <lvgl.h>
#include <zephyr/kernel.h>
#include <zephyr/sys/printk.h>

#include "lcd.h"
#include "ble.h"


static bool target_device_connected[BLE_CONN_CNT];
static bool target_device_vcp_discovered[BLE_CONN_CNT];
static bool connect_all_targets;
static bool vcp_discover_all_targets;
static bool all_devices_detected;
static uint8_t aics_inst_cnt[VCP_MAX_AICS_INST];
static uint8_t vocs_inst_cnt[VCP_MAX_VOCS_INST];
static uint8_t aics_mute[VCP_MAX_AICS_INST];
static int8_t aics_gain[VCP_MAX_AICS_INST];
static int16_t vocs_offset[VCP_MAX_VOCS_INST];
static uint8_t vcs_volume = VOLUME_DEFAULT;
static uint8_t vcs_mute = 0;

static lv_obj_t *scr;
static lv_obj_t *vcs_volume_slider;
static lv_obj_t *vcs_voice_icon;
static lv_obj_t *vocs_slider[VCP_MAX_VOCS_INST];
static lv_obj_t *vocs_voice_icon[VCP_MAX_VOCS_INST];
static lv_obj_t *aics_slider[VCP_MAX_AICS_INST];
static lv_obj_t *aics_voice_icon[VCP_MAX_AICS_INST];
static lv_obj_t *msg_label;

#if (BLE_CONN_CNT == 2)
static bool vocs_offset_changed;
static bool aics_gain_changed;
static bool aics_mute_changed;
static bool vcs_volume_changed;
static bool vcs_mute_changed;
#endif


static void vcs_volume_slider_event_cb(lv_event_t *e)
{
    lv_obj_t *slider = lv_event_get_target(e);
    int16_t value = lv_slider_get_value(slider);

    vcs_volume = value;
    ble_update_volume(conn_tgt, value);

#if (BLE_CONN_CNT == 2)
    vcs_volume_changed = true;
#endif
}

static void vocs_slider_event_cb(lv_event_t *e)
{
    lv_obj_t *slider = lv_event_get_target(e);
    int16_t value = lv_slider_get_value(slider);

    for (uint8_t i = 0; i < VCP_MAX_VOCS_INST; i++) {
        if(slider == vocs_slider[i]) {
            vocs_offset[i] = value;
            ble_update_vocs_offset(conn_tgt, i, value);

#if (BLE_CONN_CNT == 2)
            vocs_offset_changed = true;
#endif
        }
    }
}

static void aics_slider_event_cb(lv_event_t *e)
{
    lv_obj_t *slider = lv_event_get_target(e);
    int16_t value = lv_slider_get_value(slider);

    for (uint8_t i = 0; i < VCP_MAX_AICS_INST; i++) {
        if(slider == aics_slider[i]) {
            aics_gain[i] = value;
            ble_update_aics_gain(conn_tgt, i, value);

#if (BLE_CONN_CNT == 2)
            aics_gain_changed = true;
#endif
       }
    }
}

static void vcs_voice_icon_event_cb(lv_event_t *e)
{
    lv_obj_t *icon = lv_event_get_target(e);

    vcs_mute = !vcs_mute;
    ble_update_volume_mute(conn_tgt, vcs_mute);
    lcd_change_voice_icon(icon, vcs_mute);

#if (BLE_CONN_CNT == 2)
    vcs_mute_changed = true;
#endif
}

static void aics_voice_icon_event_cb(lv_event_t *e)
{
    lv_obj_t *icon = lv_event_get_target(e);

    for (uint8_t i = 0; i < VCP_MAX_AICS_INST; i++) {
        if(icon == aics_voice_icon[i]) {
            aics_mute[i] = !aics_mute[i];
            ble_update_aics_mute(conn_tgt, i, aics_mute[i]);
            lcd_change_voice_icon(icon, aics_mute[i]);

#if (BLE_CONN_CNT == 2)
            aics_mute_changed = true;
#endif
        }
    }
}

static void create_sliders(void)
{
    char txt[10];
    lv_obj_t *vcs_volume_label;
    lv_obj_t *vocs_label[VCP_MAX_VOCS_INST];
    lv_obj_t *aics_label[VCP_MAX_AICS_INST];
    lv_coord_t scr_y = LCD_Y_MIN;
    const int dist = (LCD_Y_MAX - LCD_Y_MIN) / (VCP_MAX_VOCS_INST + VCP_MAX_AICS_INST + 2);

    lcd_clear_screen(scr);

    snprintf(txt, sizeof(txt), "Volume");
    scr_y += dist;

    vcs_volume_slider = lcd_create_slider(scr, VOLUME_MIN, VOLUME_MAX, 10, scr_y,
                                          vcs_volume_slider_event_cb);

    vcs_volume_label = lcd_create_label(scr, txt, -120, scr_y);
    vcs_voice_icon = lcd_create_voice_icon(scr, 125, scr_y, vcs_voice_icon_event_cb);

    lv_slider_set_value(vcs_volume_slider, vcs_volume, LV_ANIM_OFF);

    for (uint8_t i = 0; i < VCP_MAX_VOCS_INST; ++i) {
#if (VCP_MAX_VOCS_INST == 1)
        snprintf(txt, sizeof(txt), "Balance");
#else
        snprintf(txt, sizeof(txt), "VOCS-%d", i);
#endif
        scr_y += dist;

        vocs_slider[i] = lcd_create_slider(scr, VOCS_OFFSET_MIN, VOCS_OFFSET_MAX, 10, scr_y,
                                           vocs_slider_event_cb);

        vocs_label[i] = lcd_create_label(scr, txt, -120, scr_y);
        vocs_voice_icon[i] = lcd_create_balance_icon(scr, 125, scr_y, NULL);
    }

    for (uint8_t i = 0; i < VCP_MAX_AICS_INST; ++i) {
#if (VCP_MAX_VOCS_INST == 1)
        snprintf(txt, sizeof(txt), "AICS");
#else
        snprintf(txt, sizeof(txt), "AICS-%d", i);
#endif
        scr_y += dist;

        aics_slider[i] = lcd_create_slider(scr, AICS_GAIN_MIN, AICS_GAIN_MAX, 10, scr_y,
                                           aics_slider_event_cb);

        aics_label[i] = lcd_create_label(scr, txt, -120, scr_y);
        aics_voice_icon[i] = lcd_create_voice_icon(scr, 125, scr_y, aics_voice_icon_event_cb);
    }
}

static int connect_first_disconnected_devic(uint8_t start_conn_idx)
{
    int err;
    uint8_t conn_idx = start_conn_idx;

    do {
        err = ble_connect(conn_idx);
        if (err < 0) {
            lcd_display_message(msg_label, "Connection failed!");
            return -1;
        }
    } while ((err > 0) && (++conn_idx < BLE_CONN_CNT));

    return 0;
}

static void scan_btn_event_cb(lv_event_t *e)
{
    connect_all_targets = false;
    all_devices_detected = false;

    int err = ble_start_scan();
    if (err < 0) {
        lcd_display_message(msg_label, "Start scanning failed!");
        return;
    }

    lcd_display_message(msg_label, "Scanning started.");
}

static void connect_btn_event_cb(lv_event_t *e)
{
    connect_all_targets = true;
    lcd_display_message(msg_label, "Connecting...");

    if (all_devices_detected) {
        uint8_t first_conn_idx = 0;
        int err = connect_first_disconnected_devic(first_conn_idx);
        if (err) {
            lcd_display_message(msg_label, "Connection failed!");
        }
    } else {
        int err = ble_start_scan_force();
        if (err) {
            lcd_display_message(msg_label, "Start scanning failed!");
        }
    }
}

static void discover_btn_event_cb(lv_event_t *e)
{
    for (uint8_t i = 0; i < BLE_CONN_CNT; i++) {
        target_device_vcp_discovered[i] = false;
    }

    vcp_discover_all_targets = true;
    uint8_t first_conn_idx = 0;
    int err = ble_vcp_discover(first_conn_idx);
    if (err) {
        char txt[50];
        snprintf(txt, sizeof(txt), "Connection %d: VCP discover failed!", first_conn_idx);
        lcd_display_message(msg_label, txt);
        return;
    }

    lcd_display_message(msg_label, "Start discovering VCP...");
}

static void disconnect_btn_event_cb(lv_event_t *e)
{
    for (uint8_t i = 0; i < BLE_CONN_CNT; i++) {
        if (target_device_connected[i]) {
            int err = ble_disconnect(i);
            if (err) {
                char txt[50];
                snprintf(txt, sizeof(txt), "Connection %d: failed to disconnect!", i);
                lcd_display_message(msg_label, txt);
            }
        }
    }

    connect_all_targets = false;
    vcp_discover_all_targets = false;
}

static void create_buttons_before_connecting(void)
{
    lv_obj_t *connect_btn, *scan_btn;

    lcd_clear_screen(scr);

    connect_btn = lcd_create_button(scr, "Connect", 100, 50, -60, -20, connect_btn_event_cb);
    scan_btn = lcd_create_button(scr, "Scan", 100, 50, 60, -20, scan_btn_event_cb);

    msg_label = lcd_create_label(scr, "Not connected.", 0, 50);
}

static void create_buttons_after_connecting(void)
{
    lv_obj_t *discover_btn, *disconnect_btn;

    lcd_clear_screen(scr);

    discover_btn = lcd_create_button(scr, "VCP Discover", 160, 50, 0, 0, discover_btn_event_cb);
    disconnect_btn = lcd_create_button(scr, "Disconnect", 120, 40, -75, -75,
                                       disconnect_btn_event_cb);

    msg_label = lcd_create_label(scr, "Connected.", 0, 70);
}

static void create_buttons(conn_status_t all_conn)
{
    static bool buttons_before_connecting_created = false;
    static bool buttons_after_connecting_created = false;

    if (all_conn != conn_connected) {
        if (!buttons_before_connecting_created) {
            create_buttons_before_connecting();
            buttons_before_connecting_created = true;
            buttons_after_connecting_created = false;
        }
    } else {
        if(!buttons_after_connecting_created) {
            create_buttons_after_connecting();
            buttons_before_connecting_created = false;
            buttons_after_connecting_created = true;
        }
    }
}

static void scan_device_status(scan_status_t scan_st,
                               const char *dev_name)
{
    switch (scan_st) {
    case scan_available:
        char txt[MAX_DEVICE_NAME_LEN + 20];
        snprintf(txt, sizeof(txt), "Found device: %s", dev_name);
        lcd_display_message(msg_label, txt);
        break;
    case scan_done:
        all_devices_detected = true;
        printk("All devices found.\n");
        lcd_display_message(msg_label, "All devices found.");

        if (connect_all_targets) {
            lcd_display_message(msg_label, "Connecting...");

            uint8_t first_conn_idx = 0;
            int err = connect_first_disconnected_devic(first_conn_idx);
            if (err) {
                lcd_display_message(msg_label, "Connection failed!");
            }
        }
        break;
    case scan_timeout:
        printk("Some devices not found!\n");
        lcd_display_message(msg_label, "Scan timeout!\nSome devices not found!");
        break;
    default:
        printk("Unknown scan status!\n");
        break;
    }
}

static void device_connection_status(uint8_t conn_idx, conn_status_t conn_st)
{
    if (conn_idx >= BLE_CONN_CNT) {
        printk("Connection index is not valid!\n");
        return;
    }

    switch (conn_st) {
    case conn_connected:
        target_device_connected[conn_idx] = true;
        printk("Device %d connected successfully.\n", conn_idx);

        if (connect_all_targets) {
            uint8_t next_conn = conn_idx + 1;
            if (next_conn < BLE_CONN_CNT) {
                if(!target_device_connected[next_conn]) {
                    int err = connect_first_disconnected_devic(next_conn);
                    if (err) {
                        char txt[50];
                        snprintf(txt, sizeof(txt), "Connection %d: failed!", next_conn);
                        lcd_display_message(msg_label, txt);
                        return;
                    }
                }
            }
        }
        break;
    case conn_disconnected:
        target_device_connected[conn_idx] = false;
        connect_all_targets = false;
        all_devices_detected = false;

        printk("Device %d disconnected successfully.\n", conn_idx);
        create_buttons(conn_disconnected);
        break;
    default:
        printk("Connection status value is not valid!\n");
        return;
    }

    for (uint8_t i = 0; i < BLE_CONN_CNT; i++) {
        if (!target_device_connected[i]) {
            return;
        }
    }

    connect_all_targets = false;
    printk("All devices connected successfully.\n");
    create_buttons(conn_connected);
}

static void vcp_status(vcp_type_t cb_type, void *vcp_user_data)
{
#if (BLE_CONN_CNT == 2)
    uint8_t next_conn_idx;
#endif

    switch (cb_type) {
    case vcp_discover:
        vcp_discover_t *disc_data = (vcp_discover_t *)vcp_user_data;

        if (disc_data->conn_idx >= BLE_CONN_CNT) {
            printk("Connection index is not valid!\n");
            return;
        }

        if (disc_data->err != 0) {
            char txt[50];
            snprintf(txt, sizeof(txt), "Connection %d: VCP discover failed (err: %d)",
                     disc_data->conn_idx, disc_data->err);
            lcd_display_message(msg_label, txt);

            printk("Connection %d: VCP discover get failed (err: %d)\n",
                   disc_data->conn_idx, disc_data->err);

            return;
        }

        vocs_inst_cnt[disc_data->conn_idx] = disc_data->vocs_count;
        aics_inst_cnt[disc_data->conn_idx] = disc_data->aics_count;

        target_device_vcp_discovered[disc_data->conn_idx] = true;
        printk("Connection %d: VCP discovered successfully\n", disc_data->conn_idx);

        if (vcp_discover_all_targets) {
            uint8_t next_conn = disc_data->conn_idx + 1;
            if (next_conn < BLE_CONN_CNT) {
                if(!target_device_vcp_discovered[next_conn]) {
                    int err = ble_vcp_discover(next_conn);
                    if (err) {
                        char txt[50];
                        snprintf(txt, sizeof(txt), "Connection %d: VCP discover failed (err: %d)",
                                 next_conn, err);
                        lcd_display_message(msg_label, txt);
                        return;
                    }
                }
            }
        }

        for (uint8_t i = 0; i < BLE_CONN_CNT; i++) {
            if (!target_device_vcp_discovered[i]) {
                return;
            }
        }

        printk("VCP discovered for all devices successfully.\n");
        create_sliders();
        break;
    case vcp_vcs_vol_state:
        vcp_vol_state_t *vcs_state = (vcp_vol_state_t *)vcp_user_data;

        if (vcs_state->conn_idx >= BLE_CONN_CNT) {
            printk("Connection index is not valid!\n");
            return;
        }

        if (vcs_state->err != 0) {
            printk("VOCS state get failed (%d)\n", vcs_state->err);
            return;
        }

        printk("Connection %d: VCS volume = %u, mute = %u\n",
               vcs_state->conn_idx, vcs_state->volume, vcs_state->mute);

#if (BLE_CONN_CNT == 2)
        next_conn_idx = (vcs_state->conn_idx != conn_rshi) ? conn_rshi : conn_lshi;

        if (vcs_volume_changed || (vcs_volume != vcs_state->volume)) {
            ble_update_volume(next_conn_idx, vcs_state->volume);
            vcs_volume_changed = false;
        }

        if (vcs_mute_changed || (vcs_mute != vcs_state->mute)) {
            ble_update_volume_mute(next_conn_idx, vcs_state->mute);
            vcs_mute_changed = false;
        }
#endif
        vcs_volume = vcs_state->volume;
        vcs_mute = vcs_state->mute;

        lv_slider_set_value(vcs_volume_slider, vcs_volume, LV_ANIM_OFF);
        lcd_change_voice_icon(vcs_voice_icon, vcs_mute);
        break;
    case vcp_vocs_state:
        vcp_vocs_state_t *vocs_state = (vcp_vocs_state_t *)vcp_user_data;

        if (vocs_state->conn_idx >= BLE_CONN_CNT) {
            printk("Connection index is not valid!\n");
            return;
        }

        if (vocs_state->inst_idx >= vocs_inst_cnt[vocs_state->conn_idx]) {
            printk("VOCS inst. index is not valid!\n");
            return;
        }

        if (vocs_state->err != 0) {
            printk("VOCS state get failed (%d) for inst. index %d\n",
                   vocs_state->err, vocs_state->inst_idx);
            return;
        }

        printk("Connection %d: VOCS-%d offset = %d\n",
               vocs_state->conn_idx, vocs_state->inst_idx, vocs_state->offset);

#if (BLE_CONN_CNT == 1)
        vocs_offset[vocs_state->inst_idx] = vocs_state->offset;
#elif (BLE_CONN_CNT == 2)
        int16_t new_offset = (vocs_state->conn_idx != conn_rshi) ?
                             -(vocs_state->offset) : vocs_state->offset;

        next_conn_idx = (vocs_state->conn_idx != conn_rshi) ? conn_rshi : conn_lshi;

        if (vocs_offset_changed || (vocs_offset[vocs_state->inst_idx] != new_offset)) {
            ble_update_vocs_offset(next_conn_idx, vocs_state->inst_idx, -(vocs_state->offset));
            vocs_offset_changed = false;
        }

        vocs_offset[vocs_state->inst_idx] = new_offset;
#endif
        lv_slider_set_value(vocs_slider[vocs_state->inst_idx],
                            vocs_offset[vocs_state->inst_idx],
                            LV_ANIM_OFF);
        break;
    case vcp_aics_state:
        vcp_aics_state_t *aics_state = (vcp_aics_state_t *)vcp_user_data;

        if (aics_state->conn_idx >= BLE_CONN_CNT) {
            printk("Connection index is not valid!\n");
            return;
        }

        if (aics_state->inst_idx >= aics_inst_cnt[aics_state->conn_idx]) {
            printk("AICS inst. index is not valid!\n");
            return;
        }

        if (aics_state->err != 0) {
            printk("AICS state get failed (%d) for inst. index %d\n",
                   aics_state->err, aics_state->inst_idx);
            return;
        }

        printk("Connection %d: AICS-%d gain = %d, mute = %u, mode = %u\n",
               aics_state->conn_idx, aics_state->inst_idx,
               aics_state->gain, aics_state->mute, aics_state->mode);

#if (BLE_CONN_CNT == 2)
        next_conn_idx = (aics_state->conn_idx != conn_rshi) ? conn_rshi : conn_lshi;

        if (aics_gain_changed || (aics_gain[aics_state->inst_idx] != aics_state->gain)) {
            ble_update_aics_gain(next_conn_idx, aics_state->inst_idx, aics_state->gain);
            aics_gain_changed = false;
        }

        if (aics_mute_changed || (aics_mute[aics_state->inst_idx] != aics_state->mute)) {
            ble_update_aics_mute(next_conn_idx, aics_state->inst_idx, aics_state->mute);
            aics_mute_changed = false;
        }
#endif
        aics_gain[aics_state->inst_idx] = aics_state->gain;
        aics_mute[aics_state->inst_idx] = aics_state->mute;

        lv_slider_set_value(aics_slider[aics_state->inst_idx],
                            aics_gain[aics_state->inst_idx],
                            LV_ANIM_OFF);
        lcd_change_voice_icon(aics_voice_icon[aics_state->inst_idx],
                              aics_mute[aics_state->inst_idx]);
        break;
    default:
        printk("VCP status: undefined parameter!\n");
        break;
    }
}

static int bt_init(void)
{
    int err;

    err = ble_bt_init();
    if (!err) {
        ble_scan_status_cb_register(&scan_device_status);
        ble_conn_status_cb_register(&device_connection_status);
        ble_vcp_status_cb_register(&vcp_status);
    }

    return err;
}


int main(void)
{
    int err;

    err = bt_init();
    if(err) {
        printk("BT init failed!\n");
        return 0;
    }
    printk("BT initialized.\n");

    scr = lv_scr_act();

    err = lcd_init();
    if (err) {
        printk("Device not ready!\n");
        return 0;
    }
    printk("Display initialized.\n");

    create_buttons(conn_disconnected);

    while (1) {
        lv_task_handler();
        k_sleep(K_MSEC(50));
    }
}
```

## src/ble.c
```c
/*
 * Copyright (c) 2024 Demant A/S
 * SPDX-License-Identifier: Apache-2.0
 */

/* Bluetooth LE management */

#include <errno.h>
#include <stdlib.h>
#include <string.h>
#include <strings.h>
#include <zephyr/kernel.h>
#include <zephyr/sys/printk.h>
#include <zephyr/bluetooth/bluetooth.h>
#include <zephyr/bluetooth/conn.h>
#include <zephyr/bluetooth/audio/vcp.h>
#include <zephyr/bluetooth/audio/aics.h>
#include <zephyr/bluetooth/audio/vocs.h>

#include "ble.h"


#define TGT_DEV_NAME        CONFIG_BT_TARGET_DEVICE_NAME
#define RSHI_DEV_NAME       CONFIG_BT_TARGET_RSHI_DEVICE_NAME
#define LSHI_DEV_NAME       CONFIG_BT_TARGET_LSHI_DEVICE_NAME

#if (BLE_CONN_CNT == 2)
#define INIT_DEV_NAME { \
    RSHI_DEV_NAME, \
    LSHI_DEV_NAME \
}
#else
#define INIT_DEV_NAME { \
    TGT_DEV_NAME \
}
#endif

#define SCAN_TIMEOUT_SEC    10

static struct bt_conn *ble_conn[BLE_CONN_CNT];
static struct bt_vcp_vol_ctlr *vcp_vol_ctlr[BLE_CONN_CNT];
static struct bt_vcp_included vcp_included[BLE_CONN_CNT];

static bool ble_dev_found[BLE_CONN_CNT];
static bool ble_dev_connected[BLE_CONN_CNT];
static bt_addr_le_t pd_addr[BLE_CONN_CNT];
const char *dev_name[BLE_CONN_CNT] = INIT_DEV_NAME;
static bool scan_started;

static struct k_work_delayable scan_timeout_work;

static scan_status_callback_t *user_scan_status_cb = NULL;
static conn_status_callback_t *user_conn_status_cb = NULL;
static vcp_status_callback_t *user_vcp_status_cb = NULL;


int ble_stop_scan(void)
{
    int err = bt_le_scan_stop();
    if (err) {
        printk("Failed to stop scan: %d\n", err);
        return err;
    }

    k_work_cancel_delayable(&scan_timeout_work);

    scan_started = false;
    printk("Scan stopped.\n");

    return 0;
}

static bool scan_data_cb(struct bt_data *data, void *user_data)
{
    char *name = user_data;
    uint8_t len;

    switch (data->type) {
    case BT_DATA_NAME_SHORTENED:
    case BT_DATA_NAME_COMPLETE:
        len = MIN(data->data_len, MAX_DEVICE_NAME_LEN - 1);
        memcpy(name, data->data, len);
        name[len] = '\0';
        return false;
    default:
        return true;
    }
}

static void scan_recv_cb(const bt_addr_le_t *addr, int8_t rssi, uint8_t adv_type,
                         struct net_buf_simple *ad)
{
    char name[MAX_DEVICE_NAME_LEN];

    memset(name, 0, sizeof(name));

    bt_data_parse(ad, scan_data_cb, name);

    for (int i = 0; i < BLE_CONN_CNT; i++) {
        if (!ble_dev_found[i] && !strcmp(dev_name[i], name)) {
            char le_addr[BT_ADDR_LE_STR_LEN];

            if (addr == NULL) {
                return;
            }

            for (int j = 0; j < i; j++) {
                if (bt_addr_le_cmp(&pd_addr[j], addr) == 0) {
                    return;
                }
            }

            ble_dev_found[i] = true;
            memcpy(&pd_addr[i], addr, sizeof(pd_addr[i]));

            bt_addr_le_to_str(&pd_addr[i], le_addr, sizeof(le_addr));
            printk("Found device with name %s and address %s\n", name, le_addr);

            if (user_scan_status_cb) {
                user_scan_status_cb(scan_available, name);
            }
        }
    }

    for (int i = 0; i < BLE_CONN_CNT; i++) {
        if(!ble_dev_found[i] && !ble_dev_connected[i]) {
            return;
        }
    }

    ble_stop_scan();

    if (user_scan_status_cb) {
        user_scan_status_cb(scan_done, NULL);
    }
}

int ble_start_scan(void)
{
    int err;
    const struct bt_le_scan_param param = {
        .type       = BT_LE_SCAN_TYPE_ACTIVE,
        .options    = BT_LE_SCAN_OPT_NONE,
        .interval   = BT_GAP_SCAN_FAST_INTERVAL,
        .window     = BT_GAP_SCAN_FAST_WINDOW,
        .timeout    = 0,
    };

    if (scan_started) {
        printk("Scanning is already started!\n");
        return 1;
    }

    for (int i = 0; i < BLE_CONN_CNT; i++) {
        ble_dev_found[i] = false;
        memset(&pd_addr[i], 0, sizeof(pd_addr[i]));
    }

    err = bt_le_scan_start(&param, scan_recv_cb);
    if (err) {
        printk("Starting scanning failed (err %d)\n", err);
        return -1;
    }

    k_work_reschedule(&scan_timeout_work, K_SECONDS(SCAN_TIMEOUT_SEC));

    scan_started = true;
    printk("Scanning started.\n");

    return 0;
}

static void scan_timeout_cb(struct k_work *work)
{
    scan_started = false;
    printk("Scan timeout!\n");

    if (user_scan_status_cb) {
        user_scan_status_cb(scan_timeout ,NULL);
    }
}

int ble_start_scan_force(void)
{
    if (scan_started) {
        int err = ble_stop_scan();
        if (err) {
            return -1;
        }
    }

    return ble_start_scan();
}

static int connect_to_device(uint8_t conn_idx)
{
    char addr_str[BT_ADDR_LE_STR_LEN];

    bt_addr_le_to_str(&pd_addr[conn_idx], addr_str, sizeof(addr_str));
    printk("Connecting to connection %d (name: %s, addr: %s)...\n",
           conn_idx, dev_name[conn_idx], addr_str);

    int err = bt_conn_le_create(&pd_addr[conn_idx],
                                BT_CONN_LE_CREATE_CONN,
                                BT_LE_CONN_PARAM_DEFAULT,
                                &ble_conn[conn_idx]);
    if (err) {
        printk("Connection failed (err %d)\n", err);
        return -1;
    }

    return 0;
}

int ble_connect(uint8_t conn_idx)
{
    if (ble_dev_connected[conn_idx]) {
        printk("Connection %d: already connected!\n", conn_idx);
        return 1;
    }

    if (scan_started) {
        int err = ble_stop_scan();
        if (err) {
            return -1;
        }
    }

    return connect_to_device(conn_idx);
}

int ble_disconnect(uint8_t conn_idx)
{
    if (!ble_dev_connected[conn_idx] || (ble_conn[conn_idx] == NULL)) {
        printk("Connection %d: no connection available!\n", conn_idx);
        return 1;
    }

    int err = bt_conn_disconnect(ble_conn[conn_idx], BT_HCI_ERR_REMOTE_USER_TERM_CONN);
    if (err) {
        printk("Connection %d: failed to disconnect (err %d)\n", conn_idx, err);
        return -1;
    }

    return 0;
}

static void vcp_discover_cb(struct bt_vcp_vol_ctlr *vol_ctlr, int err, uint8_t vocs_count,
                            uint8_t aics_count)
{
    int conn_idx = -1;
    int disc_err = 0;

    for (int i = 0; i < BLE_CONN_CNT; i++) {
        if (vol_ctlr == vcp_vol_ctlr[i]) {
            conn_idx = i;
        }
    }

    if (conn_idx == -1) {
        return;
    }

    if (err) {
        disc_err = -1;
        printk("Connection %d; VCP discover failed (%d)\n", conn_idx, err);
    } else {
        int res = bt_vcp_vol_ctlr_included_get(vol_ctlr, &vcp_included[conn_idx]);
        if (res) {
            disc_err = -2;
            printk("Connecion %d: could not get VCP context!\n", conn_idx);
        }
    }

    if (user_vcp_status_cb) {
        vcp_discover_t discover;
        discover.conn_idx = conn_idx;
        discover.err = disc_err;
        discover.vocs_count = vcp_included[conn_idx].vocs_cnt;
        discover.aics_count = vcp_included[conn_idx].aics_cnt;

        user_vcp_status_cb(vcp_discover, &discover);
    }
}

static void vcp_volume_state_cb(struct bt_vcp_vol_ctlr *vol_ctlr, int err, uint8_t volume,
                                uint8_t mute)
{
    int conn_idx = -1;

    for (int i = 0; i < BLE_CONN_CNT; i++) {
        if (vol_ctlr == vcp_vol_ctlr[i]) {
            conn_idx = i;
        }
    }

    if (conn_idx == -1) {
        return;
    }

    if (user_vcp_status_cb) {
        vcp_vol_state_t state;
        state.conn_idx = conn_idx;
        state.err = err;
        state.volume = volume;
        state.mute = mute;

        user_vcp_status_cb(vcp_vcs_vol_state, &state);
    }
}

static void vcp_vocs_state_cb(struct bt_vocs *inst, int err, int16_t offset)
{
    for (int i = 0; i < BLE_CONN_CNT; i++) {
        for (int j = 0; j < vcp_included[i].vocs_cnt; ++j) {
            if (vcp_included[i].vocs[j] == inst) {
                if (user_vcp_status_cb) {
                    vcp_vocs_state_t state;
                    state.conn_idx = i;
                    state.inst_idx = j;
                    state.err = err;
                    state.offset = offset;

                    user_vcp_status_cb(vcp_vocs_state, &state);
                }
            }
        }
    }
}

static void vcp_aics_state_cb(struct bt_aics *inst, int err, int8_t gain, uint8_t mute,
                              uint8_t mode)
{
    for (int i = 0; i < BLE_CONN_CNT; i++) {
        for (uint8_t j = 0; j < vcp_included[i].aics_cnt; ++j) {
            if (vcp_included[i].aics[j] == inst) {
                if (user_vcp_status_cb) {
                    vcp_aics_state_t state;
                    state.conn_idx = i;
                    state.inst_idx = j;
                    state.err = err;
                    state.gain = gain;
                    state.mute = mute;
                    state.mode = mode;

                    user_vcp_status_cb(vcp_aics_state, &state);
                }
            }
        }
    }
}

static struct bt_vcp_vol_ctlr_cb vcp_cbs = {
    .discover = vcp_discover_cb,
    .state = vcp_volume_state_cb,
    .vocs_cb = {
        .state = vcp_vocs_state_cb,
    },
    .aics_cb = {
        .state = vcp_aics_state_cb,
    }
};

int ble_vcp_discover(uint8_t conn_idx)
{
    if (ble_conn[conn_idx] == NULL) {
        printk("Connection %d: not connected!\n", conn_idx);
        return -2;
    }

    int err = bt_vcp_vol_ctlr_discover(ble_conn[conn_idx], &vcp_vol_ctlr[conn_idx]);
    if (err != 0) {
        printk("Connection %d: VCP discovering failed: %d\n", conn_idx, err);
        return -3;
    }

    return 0;
}

int ble_update_volume(uint8_t conn_idx, uint8_t volume)
{
    int result;

    if (ble_conn[conn_idx] == NULL) {
        printk("Connection %d: not connected!\n", conn_idx);
        return -2;
    }

    result = bt_vcp_vol_ctlr_set_vol(vcp_vol_ctlr[conn_idx], volume);

    if (result != 0) {
        printk("Connection %d: volume set failed: %d\n", conn_idx, result);
        return -1;
    }

    return 0;
}

int ble_update_volume_mute(uint8_t conn_idx, uint8_t mute)
{
    int result;

    if (ble_conn[conn_idx] == NULL) {
        printk("Connection %d: not connected!\n", conn_idx);
        return -2;
    }

    if (mute) {
        result = bt_vcp_vol_ctlr_mute(vcp_vol_ctlr[conn_idx]);

    } else {
        result = bt_vcp_vol_ctlr_unmute(vcp_vol_ctlr[conn_idx]);
    }

    if (result != 0) {
        printk("Connection %d: volume mute/unmute set failed: %d\n", conn_idx, result);
        return -1;
    }

    return 0;
}

int ble_update_vocs_offset(uint8_t conn_idx, uint8_t inst_idx, int16_t offset)
{
    int result;

    if(inst_idx > vcp_included[conn_idx].vocs_cnt) {
        printk("Connection %d: VOCS inst. index is not valid: %d\n", conn_idx, inst_idx);
        return -1;
    }

    result = bt_vocs_state_set(vcp_included[conn_idx].vocs[inst_idx], offset);
    if (result != 0) {
        printk("Connection %d: VOCS offset set failed: %d\n", conn_idx, result);
        return -1;
    }

    return 0;
}

int ble_update_aics_gain(uint8_t conn_idx, uint8_t inst_idx, int8_t gain)
{
    int result;

    if(inst_idx > vcp_included[conn_idx].aics_cnt) {
        printk("Connection %d: AICS inst. index is not valid: %d\n", conn_idx, inst_idx);
        return -1;
    }

    result = bt_aics_gain_set(vcp_included[conn_idx].aics[inst_idx], gain);
    if (result != 0) {
        printk("Connection %d: AICS gain set failed: %d\n", conn_idx, result);
        return -1;
    }

    return 0;
}

int ble_update_aics_mute(uint8_t conn_idx, uint8_t inst_idx, uint8_t mute)
{
    int result;

    if(inst_idx > vcp_included[conn_idx].aics_cnt) {
        printk("Connection %d: AICS inst. index is not valid: %d\n", conn_idx, inst_idx);
        return -1;
    }

    if (mute) {
        result = bt_aics_mute(vcp_included[conn_idx].aics[inst_idx]);

    } else {
        result = bt_aics_unmute(vcp_included[conn_idx].aics[inst_idx]);
    }

    if (result != 0) {
        printk("Connection %d: AICS mute/unmute set failed: %d\n", conn_idx, result);
        return -1;
    }

    return 0;
}

static void connected(struct bt_conn *conn, uint8_t conn_err)
{
    int conn_idx = -1;

    for (int i = 0; i < BLE_CONN_CNT; i++) {
        if (conn == ble_conn[i]) {
            conn_idx = i;
        }
    }

    if (conn_idx == -1) {
        return;
    }

    if (conn_err) {
        printk("Connection failed (conn=%d, err=%u)\n", conn_idx, conn_err);
        bt_conn_unref(conn);
        return;
    }

    ble_dev_connected[conn_idx] = true;
    printk("Connection %d: connected.\n", conn_idx);

    if (user_conn_status_cb) {
        user_conn_status_cb(conn_idx, conn_connected);
    }
}

static void disconnected(struct bt_conn *conn, uint8_t reason)
{
    int conn_idx = -1;

    for (int i = 0; i < BLE_CONN_CNT; i++) {
        if (conn == ble_conn[i]) {
            conn_idx = i;
        }
    }

    if (conn_idx == -1) {
        return;
    }

    ble_dev_connected[conn_idx] = false;
    printk("Connection %d: disconnected (reason %u)\n", conn_idx,reason);
    bt_conn_unref(ble_conn[conn_idx]);

    if (user_conn_status_cb) {
        user_conn_status_cb(conn_idx, conn_disconnected);
    }
}

static struct bt_conn_cb conn_callbacks = {
    .connected = connected,
    .disconnected = disconnected,
};

int ble_bt_init(void)
{
    int err;

    err = bt_enable(NULL);
    if (err) {
        printk("BT enable failed! (err %d)\n", err);
        return -1;
    }

    k_work_init_delayable(&scan_timeout_work, scan_timeout_cb);

    bt_conn_cb_register(&conn_callbacks);

    err = bt_vcp_vol_ctlr_cb_register(&vcp_cbs);
    if (err) {
        printk("CB register failed: %d\n", err);
        return -2;
    }

    return 0;
}

void ble_scan_status_cb_register(scan_status_callback_t *scan_status_cb)
{
    user_scan_status_cb = scan_status_cb;
}

void ble_conn_status_cb_register(conn_status_callback_t *conn_status_cb)
{
    user_conn_status_cb = conn_status_cb;
}

void ble_vcp_status_cb_register(vcp_status_callback_t *vcp_status_cb)
{
    user_vcp_status_cb = vcp_status_cb;
}
```

## src/ble.h
```c
/*
 * Copyright (c) 2024 Demant A/S
 * SPDX-License-Identifier: Apache-2.0
 */

/* Header for BLE management */

#ifndef __BLE_H
#define __BLE_H

#define MAX_DEVICE_NAME_LEN     32

#define BLE_CONN_CNT            CONFIG_BT_TARGET_DEVICE_NUMBER

#define VCP_MAX_VOCS_INST       CONFIG_BT_VCP_VOL_CTLR_MAX_VOCS_INST
#define VCP_MAX_AICS_INST       CONFIG_BT_VCP_VOL_CTLR_MAX_AICS_INST

#define VOLUME_MAX              255
#define VOLUME_MIN              0
#define VOLUME_DEFAULT          128
#define VOCS_OFFSET_MAX         255
#define VOCS_OFFSET_MIN         -255
#define AICS_GAIN_MAX           127
#define AICS_GAIN_MIN           -128


typedef enum
{
    scan_timeout = -1,
    scan_unavailable,
    scan_available,
    scan_done,
} scan_status_t;

typedef enum
{
    conn_disconnected = 0,
    conn_connected,
} conn_status_t;

typedef enum
{
    vcp_discover,
    vcp_vcs_vol_state,
    vcp_vocs_state,
    vcp_aics_state,
} vcp_type_t;

typedef struct
{
    uint8_t conn_idx;
    int err;
    uint8_t vocs_count;
    uint8_t aics_count;
} vcp_discover_t;

typedef struct
{
    uint8_t conn_idx;
    int err;
    uint8_t volume;
    uint8_t mute;
} vcp_vol_state_t;

typedef struct
{
    uint8_t conn_idx;
    uint8_t inst_idx;
    int err;
    int16_t offset;
} vcp_vocs_state_t;

typedef struct
{
    uint8_t conn_idx;
    uint8_t inst_idx;
    int err;
    int8_t gain;
    uint8_t mute;
    uint8_t mode;
} vcp_aics_state_t;

enum
{
    conn_unknown = -1,
    conn_tgt = 0,
    conn_rshi = 0,
    conn_lshi = 1,
    conn_undefined,
};


typedef void (scan_status_callback_t) (scan_status_t scan_st, const char *dev_name);
typedef void (conn_status_callback_t) (uint8_t conn_idx, conn_status_t conn_st);
typedef void (vcp_status_callback_t) (vcp_type_t cb_type, void *vcp_user_data);


int ble_bt_init(void);
int ble_stop_scan(void);
int ble_start_scan(void);
int ble_start_scan_force(void);
int ble_connect(uint8_t conn_idx);
int ble_disconnect(uint8_t conn_idx);
int ble_vcp_discover(uint8_t conn_idx);
int ble_update_volume(uint8_t conn_idx, uint8_t volume);
int ble_update_volume_mute(uint8_t conn_idx, uint8_t mute);
int ble_update_vocs_offset(uint8_t conn_idx, uint8_t inst_idx, int16_t offset);
int ble_update_aics_gain(uint8_t conn_idx, uint8_t inst_idx, int8_t gain);
int ble_update_aics_mute(uint8_t conn_idx, uint8_t inst_idx, uint8_t mute);

void ble_scan_status_cb_register(scan_status_callback_t *scan_status_cb);
void ble_conn_status_cb_register(conn_status_callback_t *conn_status_cb);
void ble_vcp_status_cb_register(vcp_status_callback_t *vcp_status_cb);

#endif /* __BLE_H */
```

## src/lcd.c
```c
/*
 * Copyright (c) 2024 Demant A/S
 * SPDX-License-Identifier: Apache-2.0
 */

/* Touch screen LCD display management */

#include <errno.h>
#include <stdlib.h>
#include <string.h>
#include <lvgl.h>
#include <zephyr/kernel.h>
#include <zephyr/sys/printk.h>
#include <zephyr/device.h>
#include <zephyr/drivers/display.h>

#include "lcd.h"


static const lv_style_prop_t slider_props[] = {LV_STYLE_BG_COLOR, 0};
static lv_style_transition_dsc_t slider_trans_dsc;

static lv_style_t slider_style_main;
static lv_style_t slider_style_indicator;
static lv_style_t slider_style_knob;
static lv_style_t slider_style_pressed_color;

static lv_style_prop_t button_props[] = { LV_STYLE_OUTLINE_WIDTH, LV_STYLE_OUTLINE_OPA, 0 };
static lv_style_transition_dsc_t button_trans_dsc;

static lv_style_t button_style;
static lv_style_t button_style_pressed;

static lv_style_t voice_icon_style;
static lv_style_t mute_icon_style;

static bool msg_label_created;


static void lcd_slider_style_init(void)
{
    lv_style_transition_dsc_init(&slider_trans_dsc, slider_props, lv_anim_path_linear,
                                 300, 0, NULL);

    lv_style_init(&slider_style_main);
    lv_style_set_bg_opa(&slider_style_main, LV_OPA_COVER);
    lv_style_set_bg_color(&slider_style_main, lv_palette_main(LV_PALETTE_LIGHT_GREEN));
    lv_style_set_radius(&slider_style_main, LV_RADIUS_CIRCLE);
    lv_style_set_pad_ver(&slider_style_main, -2);

    lv_style_init(&slider_style_indicator);
    lv_style_set_bg_opa(&slider_style_indicator, LV_OPA_COVER);
    lv_style_set_bg_color(&slider_style_indicator, lv_palette_darken(LV_PALETTE_GREEN, 3));
    lv_style_set_radius(&slider_style_indicator, LV_RADIUS_CIRCLE);
    lv_style_set_transition(&slider_style_indicator, &slider_trans_dsc);

    lv_style_init(&slider_style_knob);
    lv_style_set_bg_opa(&slider_style_knob, LV_OPA_COVER);
    lv_style_set_bg_color(&slider_style_knob, lv_palette_darken(LV_PALETTE_RED, 3));
    lv_style_set_border_color(&slider_style_knob, lv_palette_darken(LV_PALETTE_RED, 5));
    lv_style_set_border_width(&slider_style_knob, 1);
    lv_style_set_radius(&slider_style_knob, LV_RADIUS_CIRCLE);
    lv_style_set_pad_all(&slider_style_knob, 4);
    lv_style_set_transition(&slider_style_knob, &slider_trans_dsc);

    lv_style_init(&slider_style_pressed_color);
    lv_style_set_bg_color(&slider_style_pressed_color, lv_palette_lighten(LV_PALETTE_GREEN, 3));
}

static void lcd_button_style_init(void)
{
    lv_style_init(&button_style);
    lv_style_set_radius(&button_style, 3);

    lv_style_set_bg_opa(&button_style, LV_OPA_100);
    lv_style_set_bg_color(&button_style, lv_palette_main(LV_PALETTE_DEEP_PURPLE));
    lv_style_set_bg_grad_color(&button_style,
                               lv_palette_darken(LV_PALETTE_DEEP_PURPLE, 1));
    lv_style_set_bg_grad_dir(&button_style, LV_GRAD_DIR_VER);

    lv_style_set_border_opa(&button_style, LV_OPA_100);
    lv_style_set_border_width(&button_style, 2);
    lv_style_set_border_color(&button_style,
                              lv_palette_darken(LV_PALETTE_DEEP_PURPLE, 2));

    lv_style_set_outline_opa(&button_style, LV_OPA_COVER);
    lv_style_set_outline_color(&button_style, lv_palette_darken(LV_PALETTE_DEEP_PURPLE, 3));

    lv_style_set_text_color(&button_style, lv_palette_main(LV_PALETTE_AMBER));
    lv_style_set_pad_all(&button_style, 10);

    lv_style_init(&button_style_pressed);

    lv_style_set_outline_width(&button_style_pressed, 10);
    lv_style_set_outline_opa(&button_style_pressed, LV_OPA_TRANSP);

    lv_style_set_bg_color(&button_style_pressed, lv_palette_darken(LV_PALETTE_DEEP_PURPLE, 2));
    lv_style_set_bg_grad_color(&button_style_pressed,
                               lv_palette_darken(LV_PALETTE_DEEP_PURPLE, 4));

    lv_style_transition_dsc_init(&button_trans_dsc, button_props, lv_anim_path_linear,
                                 100, 0, NULL);
    lv_style_set_transition(&button_style_pressed, &button_trans_dsc);
}

static void lcd_common_voice_style_init(lv_style_t style)
{
    lv_style_init(&style);

    lv_style_set_bg_opa(&style, LV_OPA_TRANSP);
    lv_style_set_bg_color(&style, lv_color_white());
    lv_style_set_bg_grad_color(&style, lv_color_white());
    lv_style_set_bg_grad_dir(&style, LV_GRAD_DIR_NONE);

    lv_style_set_border_opa(&style, LV_OPA_TRANSP);
    lv_style_set_border_width(&style, 0);
    lv_style_set_border_color(&style, lv_color_white());

    lv_style_set_outline_opa(&style, LV_OPA_TRANSP);
    lv_style_set_outline_color(&style, lv_color_white());

    lv_style_set_pad_all(&style, 0);
}

static void lcd_voice_icon_style_init(void)
{
    lcd_common_voice_style_init(voice_icon_style);
    lv_style_set_text_color(&voice_icon_style, lv_palette_darken(LV_PALETTE_GREEN, 4));
}

static void lcd_mute_icon_style_init(void)
{
    lcd_common_voice_style_init(mute_icon_style);
    lv_style_set_text_color(&mute_icon_style, lv_palette_main(LV_PALETTE_RED));
}

int lcd_init(void)
{
    lv_init();

    const struct device *display_dev = DEVICE_DT_GET(DT_CHOSEN(zephyr_display));

    if (!device_is_ready(display_dev)) {
        return -1;
    }

    display_blanking_off(display_dev);
    lcd_slider_style_init();
    lcd_button_style_init();
    lcd_voice_icon_style_init();
    lcd_mute_icon_style_init();

    return 0;
}

void lcd_clear_screen(lv_obj_t *parent)
{
    msg_label_created = false;
    k_sleep(K_MSEC(300));
    lv_obj_clean(parent);
    k_sleep(K_MSEC(300));
}

lv_obj_t *lcd_create_slider(lv_obj_t *parent, int16_t min_value, int16_t max_value,
                            lv_coord_t x, lv_coord_t y, lv_event_cb_t cb)
{
    lv_obj_t *slider = lv_slider_create(parent);
    lv_obj_remove_style_all(slider);

    lv_obj_add_style(slider, &slider_style_main, LV_PART_MAIN);
    lv_obj_add_style(slider, &slider_style_indicator, LV_PART_INDICATOR);
    lv_obj_add_style(slider, &slider_style_pressed_color,
                     LV_PART_INDICATOR | LV_STATE_PRESSED);
    lv_obj_add_style(slider, &slider_style_knob, LV_PART_KNOB);
    lv_obj_add_style(slider, &slider_style_pressed_color,
                     LV_PART_KNOB | LV_STATE_PRESSED);

    lv_obj_center(slider);

    lv_obj_set_width(slider, 170);
    lv_obj_set_height(slider, 15);
    lv_obj_align(slider, LV_ALIGN_CENTER, x, y);

    lv_obj_add_event_cb(slider, cb, LV_EVENT_RELEASED, NULL);

    lv_slider_set_range(slider, min_value, max_value);
    lv_slider_set_value(slider, 0, LV_ANIM_OFF);

    return slider;
}

lv_obj_t *lcd_create_button(lv_obj_t *parent, const char *text, int32_t w, int32_t h,
                            lv_coord_t x, lv_coord_t y, lv_event_cb_t cb)
{
    lv_obj_t *button = lv_btn_create(parent);
    lv_obj_remove_style_all(button);
    lv_obj_add_style(button, &button_style, LV_STATE_DEFAULT);
    lv_obj_add_style(button, &button_style_pressed, LV_STATE_PRESSED);
    lv_obj_set_size(button, w, h);
    lv_obj_align(button, LV_ALIGN_CENTER, x, y);

    lv_obj_add_event_cb(button, cb, LV_EVENT_CLICKED, NULL);

    lv_obj_t *label = lv_label_create(button);
    lv_label_set_text(label, text);
    lv_obj_center(label);

    return button;
}

lv_obj_t *lcd_create_label(lv_obj_t *parent, const char *text, lv_coord_t x, lv_coord_t y)
{
    lv_obj_t *msg_label = lv_label_create(parent);
    lv_label_set_text(msg_label, text);
    lv_obj_align(msg_label, LV_ALIGN_CENTER, x, y);

    msg_label_created = true;

    return msg_label;
}

lv_obj_t *lcd_create_voice_icon(lv_obj_t *parent, lv_coord_t x, lv_coord_t y, lv_event_cb_t cb)
{
    lv_obj_t *icon = lv_btn_create(parent);
    lv_obj_remove_style_all(icon);
    lv_obj_add_style(icon, &voice_icon_style, LV_PART_MAIN);

    lv_obj_set_size(icon, 30, 30);
    lv_obj_align(icon, LV_ALIGN_CENTER, x, y);

    lv_obj_add_event_cb(icon, cb, LV_EVENT_RELEASED, NULL);

    lv_obj_t *label = lv_label_create(icon);
    lv_label_set_text(label, LV_SYMBOL_VOLUME_MAX);
    lv_obj_center(label);

    return icon;
}

lv_obj_t *lcd_create_balance_icon(lv_obj_t *parent, lv_coord_t x, lv_coord_t y, lv_event_cb_t cb)
{
    lv_obj_t *icon = lv_btn_create(parent);
    lv_obj_remove_style_all(icon);
    lv_obj_add_style(icon, &voice_icon_style, LV_PART_MAIN);

    lv_obj_set_size(icon, 30, 30);
    lv_obj_align(icon, LV_ALIGN_CENTER, x, y);

    lv_obj_add_event_cb(icon, cb, LV_EVENT_RELEASED, NULL);

    lv_obj_t *label = lv_label_create(icon);
    lv_label_set_text(label, "L/R");
    lv_obj_center(label);

    return icon;
}

void lcd_change_voice_icon(lv_obj_t *icon, uint8_t mute)
{
    lv_obj_t *label = lv_obj_get_child(icon, 0);

    if (mute) {
        lv_obj_add_style(icon, &mute_icon_style, LV_PART_MAIN);
        lv_label_set_text(label, LV_SYMBOL_VOLUME_MID);
    } else {
        lv_obj_add_style(icon, &voice_icon_style, LV_PART_MAIN);
        lv_label_set_text(label, LV_SYMBOL_VOLUME_MAX);
    }
}

void lcd_display_message(lv_obj_t *lbl, const char *msg)
{
    if(msg_label_created) {
        lv_label_set_text(lbl, msg);
    }
}
```

## src/lcd.h
```c
/*
 * Copyright (c) 2024 Demant A/S
 * SPDX-License-Identifier: Apache-2.0
 */

/* Header for touch screen LCD display management */

#ifndef __LCD_H
#define __LCD_H

#define LCD_X_MAX   160
#define LCD_X_MIN   -160
#define LCD_Y_MAX   120
#define LCD_Y_MIN   -120


int lcd_init(void);

lv_obj_t *lcd_create_slider(lv_obj_t *parent, int16_t min_value,int16_t max_value,
                            lv_coord_t x, lv_coord_t y, lv_event_cb_t cb);
lv_obj_t *lcd_create_button(lv_obj_t *parent, const char *text, int32_t w, int32_t h,
                            lv_coord_t x, lv_coord_t y, lv_event_cb_t cb);
lv_obj_t *lcd_create_label(lv_obj_t *parent, const char *text, lv_coord_t x, lv_coord_t y);
lv_obj_t *lcd_create_voice_icon(lv_obj_t *parent, lv_coord_t x, lv_coord_t y, lv_event_cb_t cb);
lv_obj_t *lcd_create_balance_icon(lv_obj_t *parent, lv_coord_t x, lv_coord_t y, lv_event_cb_t cb);

void lcd_clear_screen(lv_obj_t *parent);
void lcd_display_message(lv_obj_t *lbl, const char *msg);
void lcd_change_voice_icon(lv_obj_t *icon, uint8_t mute);

#endif /* __LCD_H */
```
