## west.yml
```yaml
# Copyright (c) 2024 Demant A/S

manifest:
  remotes:
    - name: zephyrproject-rtos
      url-base: https://github.com/zephyrproject-rtos

  projects:
    - name: zephyr
      remote: zephyrproject-rtos
      revision: v3.7.0
      import:
        name-allowlist:
          - cmsis
          - hal_nordic
          - tinycrypt
          - libmetal
          - open-amp
          - lvgl
```
